## conf/distro/standard.conf
```bitbake
# The long name of the distribution.
# include conf/distro/poky.conf
DISTRO = "standard"
DISTRO_NAME = "This my own Distro for experimenting purposes"

RPIC_DEFAULT_DISTRO_FEATURES ?= "largefile ptest multiarch"
RPIC_DEFAULT_EXTRA_RDEPENDS ?= "packagegroup-core-boot"
RPIC_DEFAULT_EXTRA_RRECOMMENDS ?= "kernel-module-af-packet"


# The version of the distribution.
DISTRO_VERSION = "0.0.1"

# The version of the distribution.
DL_DIR = "${HOME}/downloads"

#The software support you want in your distribution for various features.
#You define your distribution features in the distribution configuration file.
#
#In most cases, the presence or absence of a feature in DISTRO_FEATURES is
#translated to the appropriate option supplied to the configure script during
#the do_configure task for recipes that optionally support the feature.
#For example, specifying "x11" in DISTRO_FEATURES, causes every piece of
#software built for the target that can optionally support X11 to have its X11
#support enabled.
#
#Two more examples are Bluetooth and NFS support. For a more complete list of
#features that ships with the Yocto Project and that you can provide with this
#variable, see the "Distro Features" section.
DISTRO_FEATURES ?= "${DISTRO_FEATURES_DEFAULT} ${DISTRO_FEATURES_LIBC} ${RPIC_DEFAULT_DISTRO_FEATURES}"

#Specifies a list of distro-specific packages to add to all images.
#This variable takes affect through packagegroup-base so the variable only
#really applies to the more full-featured images that include packagegroup-
#base. You can use this variable to keep distro policy out of generic images.
#As with all other distro variables, you set this variable in the distro .conf
#file.
DISTRO_EXTRA_RDEPENDS += " ${RPIC_DEFAULT_EXTRA_RDEPENDS}"

#Specifies a list of distro-specific packages to add to all images if the
#packages exist. The packages might not exist or be empty (e.g. kernel
#modules). The list of packages are automatically installed but you can remove
#them.
DISTRO_EXTRA_RRECOMMENDS += " ${RPIC_DEFAULT_EXTRA_RRECOMMENDS}"

#Specifies the GNU standard C library (libc) variant to use during the build
#process. This variable replaces POKYLIBC, which is no longer supported.
#
#You can select "glibc" or "musl".
TCLIBC = "glibc"
TCLIBCAPPEND = ""

PREFERRED_VERSION_linux-yocto ?= "5.4%"
LOCALCONF_VERSION = "1"
DISTRO_VERSION[vardepsexclude] = "DATE"
SDK_VERSION[vardepsexclude] = "DATE"

# SDK Config
SDK_VENDOR = "-standardsdk"
SDK_NAME = "${DISTRO}-${TCLIBC}-${SDK_ARCH}-${IMAGE_BASENAME}-${TUNE_PKGARCH}"
SDK_VERSION = "${@d.getVar('DISTRO_VERSION').replace('snapshot-${DATE}', 'snapshot')}"
SDKPATH = "/opt/${DISTRO}/${SDK_VERSION}"


#Enable systemd as target
DISTRO_FEATURES_append = " systemd"
VIRTUAL-RUNTIME_init_manager = "systemd"
DISTRO_FEATURES_BACKFILL_CONSIDERED = "sysvinit"
VIRTUAL-RUNTIME_initscripts = ""

# OELAYOUT_ABI allows us to notify users when the format of TMPDIR changes in
# an incompatible way. Such changes should usually be detailed in the commit
# that breaks the format and have been previously discussed on the mailing list
# with general agreement from the core team.
#
OELAYOUT_ABI = "14"

IMAGE_FSTYPES = "wic rpi-sdimg"

#
# Raspberry Pi specific
#

ENABLE_UART = "1"
LICENSE_FLAGS_WHITELIST += " commercial"
#MACHINE ?= "raspberrypi0-wifi"
DISTRO_FEATURES_remove += " wayland vulkan opengl"

#RPI_EXTRA_CONFIG = " \n \
#	# RPi extra conf \n \
#	# arm_control=0x200 \n \
#	# enable_uart=1 \n \
#"

ENABLE_SPI_BUS = "1"
ENABLE_I2C = "1"
RPI_USE_U_BOOT = "1"
KERNEL_MODULE_AUTOLOAD_rpi += "i2c-dev i2c-bcm2708 nl80211 cfg80211 brcmfmac brcmutil"
GPU_MEM = "16"

IMAGE_INSTALL_append = " broadcom-bt-firmware linux-firmware-bcm43430 bluez5 i2c-tools wpa-supplicant"
DISTRO_FEATURES_append = " bluez5 bluetooth wifi"

###
# Image reltated features
###
IMAGE_INSTALL_append = " \
	wlan-config \
"


###
# Image additional feature
###
IMAGE_INSTALL_append = " \
	dropbear \
	htop \
	python3 \
	nano \
	rsync \
	util-linux \
	python3-cryptography \
"




#Attempts to isolate the build system from the host distribution's C library in
#order to make re-use of native shared state artifacts across different host
#distributions practical. With this class enabled, a tarball containing a
#pre-built C library is downloaded at the start of the build. In the Poky reference
#distribution this is enabled by default through
#meta/conf/distro/include/yocto-uninative.inc. Other distributions that do not
#derive from poky can also "require conf/distro/include/yocto-uninative.inc" to use this.
#Alternatively if you prefer, you can build the uninative-tarball recipe yourself, publish
#the resulting tarball (e.g. via HTTP) and set UNINATIVE_URL and UNINATIVE_CHECKSUM appropriately.
#For an example, see the meta/conf/distro/include/yocto-uninative.inc.

#The uninative class is also used unconditionally by the extensible SDK.
#When building the extensible SDK, uninative-tarball is built and the resulting
#tarball is included within the SDK.

# QA check settings - a little stricter than the OE-Core defaults
WARN_QA = "textrel files-invalid incompatible-license xorg-driver-abi \
           libdir unknown-configure-option"
ERROR_QA = "dev-so debug-deps dev-deps debug-files arch pkgconfig la \
            perms useless-rpaths rpaths staticdev ldflags pkgvarcheck \
            already-stripped compile-host-path dep-cmp \
            installed-vs-shipped  install-host-path packages-list \
            perm-config perm-line perm-link pkgv-undefined \
            pn-overrides split-strip var-undefined version-going-backwards"


require conf/distro/include/no-static-libs.inc
require conf/distro/include/yocto-uninative.inc
require conf/distro/include/security_flags.inc

INHERIT += "uninative"
INHERIT += "reproducible_build"

BB_SIGNATURE_HANDLER ?= "OEEquivHash"
BB_HASHSERVE ??= "auto"
```
